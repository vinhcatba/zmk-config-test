## Kconfig
```kconfig
DT_COMPAT_ZMK_BEHAVIOR_SENSOR_ATTR_SET := zmk,behavior-sensor-attr-set
DT_COMPAT_ZMK_BEHAVIOR_SCROLL_SCALER := zmk,behavior-scroll-scaler
DT_COMPAT_ZMK_INPUT_PROCESSOR_SCROLL_SCALER_DYN := zmk,input-processor-scroll-scaler-dyn

config ZMK_BEHAVIOR_SENSOR_ATTR_SET
    bool
    default $(dt_compat_enabled,$(DT_COMPAT_ZMK_BEHAVIOR_SENSOR_ATTR_SET))
    imply SETTINGS

config ZMK_BEHAVIOR_SCROLL_SCALER
    bool
    default $(dt_compat_enabled,$(DT_COMPAT_ZMK_BEHAVIOR_SCROLL_SCALER))
    imply SETTINGS

config ZMK_INPUT_PROCESSOR_SCROLL_SCALER_DYN
    bool
    default $(dt_compat_enabled,$(DT_COMPAT_ZMK_INPUT_PROCESSOR_SCROLL_SCALER_DYN))
```

## config/west.yml
```yaml
manifest:
  remotes:
    - name: zmkfirmware
      url-base: https://github.com/zmkfirmware
    # Additional modules containing boards/shields/custom code can be listed here as well
    # See https://docs.zephyrproject.org/3.2.0/develop/west/manifest.html#projects
    - name: badjeff
      url-base: https://github.com/badjeff
    - name: vinhcatba
      url-base: https://github.com/vinhcatba
    - name: kot149
      url-base: https://github.com/kot149
  projects:
    - name: zmk
      remote: zmkfirmware
      revision: 4de313367288aad5aeaa1243890e40dc813f7008
      import: app/west.yml
    - name: zmk-pmw3610-driver
      remote: badjeff
      revision: main
    - name: zmk-bt-profile-led
      remote: vinhcatba
      revision: main
    - name: zmk-scroll-snap
      remote: kot149
      revision: v1
  self:
    path: config
```

## dts/bindings/behaviors/zmk,behavior-scroll-scaler.yaml
```yaml
# SPDX-License-Identifier: MIT

description: Configure dynamic scroll scaler divisor via ZMK Studio Save (no-op on keypress).

compatible: "zmk,behavior-scroll-scaler"

include: one_param.yaml
```

## dts/bindings/behaviors/zmk,behavior-sensor-attr-set.yaml
```yaml
# SPDX-License-Identifier: MIT

description: Cycle a fixed DPI list on keypress and apply custom DPI (200..3200, step 200) immediately on ZMK Studio Save.

compatible: "zmk,behavior-sensor-attr-set"

include: one_param.yaml

properties:
  sensor_device:
    required: true
    type: phandle
    description: The target sensor device to send sensor_attr_set commands to.
  values:
    required: true
    type: array
    description: Fixed list of DPI values cycled through on physical keypress.
  attr:
    required: true
    type: int
    description: The sensor attribute identifier to modify.
  persistant:
    type: boolean
    description: Persist active DPI and cycle index to flash and restore on boot.
  save_delay:
    default: 2000
    type: int
    description: Delay in ms before writing persisted state to flash.
  load_delay:
    default: 1500
    type: int
    description: Delay in ms after boot before applying restored DPI to the sensor.
```

## dts/bindings/input_processors/zmk,input-processor-scroll-scaler-dyn.yaml
```yaml
# SPDX-License-Identifier: MIT

description: Input Processor for scaling scroll values with a runtime-adjustable divisor

compatible: "zmk,input-processor-scroll-scaler-dyn"

include: ip_zero_param.yaml

properties:
  type:
    type: int
    required: true
  codes:
    type: array
    required: true
  default-divisor:
    type: int
    default: 16
```
